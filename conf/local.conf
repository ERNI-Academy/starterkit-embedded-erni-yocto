## conf/local.conf
```bitbake
# Basic local conf

CONF_VERSION = "2"

PACKAGE_CLASSES = "package_rpm"
SDKMACHINE = "x86_64"
USER_CLASSES = "buildstats"
PATCHRESOLVE = "noop"

# Directory configuration
DL_DIR ?= "${TOPDIR}/../dl"
SSTATE_DIR ?= "${TOPDIR}/../sstate"

# Extra features only for debug
# like root user without pass
EXTRA_IMAGE_FEATURES += "debug-tweaks"

# Remove work before package to save disk
INHERIT += "rm_work"

# Full Disk protection
BB_DISKMON_DIRS = "\
    STOPTASKS,${TMPDIR},1G,100K \
    STOPTASKS,${DL_DIR},1G,100K \
    STOPTASKS,${SSTATE_DIR},1G,100K \
    STOPTASKS,/tmp,100M,100K \
    ABORT,${TMPDIR},100M,1K \
    ABORT,${DL_DIR},100M,1K \
    ABORT,${SSTATE_DIR},100M,1K \
    ABORT,/tmp,10M,1K"
```

## meta-erni-pi/conf/layer.conf
```bitbake
# We have a conf and classes directory, append to BBPATH
BBPATH .= ":${LAYERDIR}"

# We have a recipes directory containing .bb and .bbappend files, add to BBFILES
BBFILES += "${LAYERDIR}/recipes*/*/*.bb \
            ${LAYERDIR}/recipes*/*/*.bbappend"

BBFILE_COLLECTIONS += "erni-pi"
BBFILE_PATTERN_erni-pi := "^${LAYERDIR}/"
BBFILE_PRIORITY_erni-pi = "9"

LAYERSERIES_COMPAT_erni-pi = "honister"
LAYERDEPENDS_erni-pi = "raspberrypi"

# Additional license directories.
#LICENSE_PATH += "${LAYERDIR}/files/custom-licenses"
```

## meta-erni/conf/distro/ideafix.conf
```bitbake
require conf/distro/include/config-file.conf
require conf/distro/include/versions.conf

# Distro settings
DISTRO = "ideafix"
DISTRO_NAME = "Ideafix (Linux OS based on Poky. Best friend of the Gaul Village of Erni embedded community)"
DISTRO_VERSION = "1.0"
DISTRO_CODENAME = "kirkstone"
MAINTAINER = "Gonzalo Matarrubia Gonzalez <g.matarrubia@gmail.com>"
hostname:pn-base-files = "ideafix"

# SDK configs
SDK_VENDOR = "-pokysdk"
SDK_VERSION = "${@d.getVar('DISTRO_VERSION').replace('snapshot-${METADATA_REVISION}', 'snapshot')}"
SDK_VERSION[vardepvalue] = "${SDK_VERSION}"

# Machine
MACHINE_FEATURES_raspberrypi3:remove = "apm"

LINUX_KERNEL_TYPE = "preempt-rt"

# Distro features
DISTRO_FEATURES:remove = "sysvinit x11"
DISTRO_FEATURES:append = " alsa bluetooth usbhost opengl pam systemd touchscreen wifi"
DISTRO_FEATURES_BACKFILL_CONSIDERED = ""
COMBINED_FEATURES += "alsa "

# Init manager configs
INIT_MANAGER = "systemd"
VIRTUAL-RUNTIME:init_manager = "systemd"
VIRTUAL-RUNTIME:initscripts = ""

CORE_IMAGE_EXTRA_INSTALL:append:raspberrypi3 = " \
    userland \
"

# Base packages
CORE_IMAGE_EXTRA_INSTALL += " \
    linux-firmware-bcm43430 \
    bridge-utils \
    hostapd \
    iptables \
    avahi-daemon \
    kernel-modules \
    openssh openssh-keygen openssh-sftp-server \
    ntp ntp-tickadj \
    packagegroup-core-boot \
    procps \
    tzdata \
    bluez5 \
    bluez5-dev \
    bluez5-noinst-tools \
    bluez5-obex \
    bluez5-testtools \
    bluealsa \
    python3-pybluez \
    alsa-lib \
    alsa-conf \
    alsa-state \
    alsa-utils \
    alsa-utils-scripts \
    canutils \
    nmap \
    usbutils \
    checksec \
    nikto \
    crda \
    iw \
    wpa-supplicant \
    xdg-user-dirs \
"

# Miscelanious Configs
IMAGE_LINGUAS = "en-US"
LICENSE_FLAGS_ACCEPTED += " commercial"
BBMASK = "meta-networking/recipes-kernel/wireguard"

PACKAGECONFIG:pn-sascha-samples = "d2d"
```

## meta-erni/conf/distro/include/versions.conf
```bitbake
# List of preferred versions

PREFERRED_VERSION:linux-raspberrypi = "5.10.%"
PREFERRED_PROVIDER:jpeg = "libjpeg-turbo"
PREFERRED_PROVIDER:jpeg-native = "libjpeg-turbo-native"
PREFERRED_VERSION:glslang = "11.6.0"
PREFERRED_VERSION:cmake = "3.21.1"
PREFERRED_VERSION:cmake-native = "3.21.1"
```
